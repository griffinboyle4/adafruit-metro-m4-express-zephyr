## boards/arm/adafruit_metro_m4_express/Kconfig.adafruit_metro_m4_express
```kconfig
# Copyright (c) 2022 Frank Dischner <frank.dischner@gmail.com>
# SPDX-License-Identifier: Apache-2.0

config BOARD_ADAFRUIT_METRO_M4_EXPRESS
	select SOC_SAMD51J19A
	select SOC_PART_NUMBER_SAMD51J19A
```

## boards/arm/adafruit_metro_m4_express/Kconfig.board
```kconfig
# Adafruit Metro M4 Express board configuration

# Copyright (c) 2022 Frank Dischner <frank.dischner@gmail.com>
# SPDX-License-Identifier: Apache-2.0

config BOARD_ADAFRUIT_METRO_M4_EXPRESS
	bool "Adafruit Metro M4 Express"
	depends on SOC_PART_NUMBER_SAMD51J19A
```

## boards/arm/adafruit_metro_m4_express/Kconfig.defconfig
```kconfig
# Adafruit Metro M4 Express board configuration

# Copyright (c) 2022 Frank Dischner <frank.dischner@gmail.com>
# SPDX-License-Identifier: Apache-2.0

config BOARD
	default "adafruit_metro_m4_express"
	depends on BOARD_ADAFRUIT_METRO_M4_EXPRESS
```

## boards/arm/adafruit_metro_m4_express/adafruit_metro_m4_express_defconfig
```kconfig
# SPDX-License-Identifier: Apache-2.0

# Configure main clock
CONFIG_SYS_CLOCK_HW_CYCLES_PER_SEC=120000000
CONFIG_SOC_ATMEL_SAMD5X_XOSC32K=y
CONFIG_SOC_ATMEL_SAMD5X_XOSC32K_AS_MAIN=y

CONFIG_USB_DRIVER_LOG_LEVEL_OFF=y
CONFIG_USB_CDC_ACM_LOG_LEVEL_OFF=y

CONFIG_CORTEX_M_SYSTICK=y
CONFIG_ARM_MPU=y
CONFIG_CONSOLE=y
CONFIG_UART_CONSOLE=y
CONFIG_UART_ASYNC_API=y
CONFIG_SERIAL=y
CONFIG_BOOTLOADER_BOSSA=y
CONFIG_BOOTLOADER_BOSSA_ADAFRUIT_UF2=y
CONFIG_BUILD_OUTPUT_HEX=y
```

## boards/arm/adafruit_metro_m4_express/board.yml
```yaml
board:
  name: adafruit_metro_m4_express
  vendor: adafruit
  socs:
    - name: samd51j19a
```
